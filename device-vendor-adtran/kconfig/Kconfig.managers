## device-vendor-adtran/kconfig/Kconfig.vendor
```kconfig
menuconfig VENDOR_IS_ADTRAN
    bool "Adtran"
    help
        Vendor Adtran.

if VENDOR_IS_ADTRAN

    config ADTRAN_SYNC_SSID_AND_PSK
        bool "sync SSID and PSK CMS <-> OpenSync"
        depends on BCM_USE_CMS
        default y
        help
            If enabled SSID and PSK will be synced at startup and if changed
            via OVSDB (OpenSync) the changes will be pushed to CSM.

    config ADTRAN_SYNC_SSID_AND_PSK_REMAP_HOME_IDX
        int "sync SSID and PSK CMS <-> OVSDB remap home APs"
        depends on ADTRAN_SYNC_SSID_AND_PSK
        default -1
        help
            In some cases the supplied device configuration file where interface
            functions are specified does not correspond to the default/native
            device configuration.

            Example: OpenSync cloud model has home AP configured as wl0.2 but default device
            configuration has home AP configured as wl0.

            If this parameter is set to other than -1, then sync algorithm will use as
            source config the vap composed as wl0.<this_parameter>.

    config ADTRAN_SYNC_HOME_BR_CONFIG
        bool "sync br0 (br-home) ip and dhcp CMS <-> OpenSync"
        default n
        help
            If enabled ip and dhcp server config will be synced fro MDM.

    config 3RDPARTY_WALLEYE
        bool "walleye"
        default n
        help
            Enables walleye 3rd party service

    config WEBROOT
        bool "weebroot"
        default n
        help
            Enables webroot 3rd party service

    config SPEEDTEST
        bool "Speedtest"
        default n
        help
            Enables speedtest 3rd party service

    if SPEEDTEST
        choice SELECT_SPEEDTEST
            prompt "Choose speedtest implementation"
            default SPEEDTEST_PLUME

            config SPEEDTEST_PLUME
                bool "Plume"
                help
                    This options enables the "st_ookla" command. This is
                    the Plume implementation of the Ookla speedtest.

            config SPEEDTEST_OOKLA
                bool "Ookla Official"
                help
                    Use the official OOKLA speedtest binary.
        endchoice

        if SPEEDTEST_OOKLA
            config SPEEDTEST_NICE
                string "Optional command to set process priority of speedtest"
                default "$(INSTALL_PREFIX)/bin/runprio.sh" if PLATFORM_IS_BCM

            config SPEEDTEST_URL
                string "Speedtest URL"
                default "http://www.speedtest.net/api/embed/plume/config"

            config SPEEDTEST_PARAM
                string "Additional parameters in speedtest URL"
                default "?threadnum=4" if PLATFORM_IS_BCM

            choice SELECT_OOKLA_WAR
                prompt "Choose ookla performance work-around"
                default OOKLA_WAR_TCP_IGNORE_CSUM

                config OOKLA_WAR_TCP_IGNORE_CSUM
                    bool "ookla perf war: sysctl ipv4/tcp_ignore_csum"
                    help
                        Use sysctl ipv4/tcp_ignore_csum for ookla performance improvement

                config OOKLA_WAR_GRO
                    bool "ookla perf war: ethtool gro"
                    help
                        Use ethtool gro for ookla performance improvement

                config OOKLA_WAR_MODULE
                    bool "ookla perf war: kernel module"
                    help
                        Use kernel module for ookla performance improvement
            endchoice
        endif
    endif
endif
```

## device-vendor-adtran/src/blem/kconfig/Kconfig.managers
```kconfig
menuconfig MANAGER_BLEM
    bool "Bluetooth Manager (BLEM)"
    default n
    help
        Enable Bluetooth Manager (BLEM)

    config MANAGER_BLEM_CFG
        depends on MANAGER_BLEM
        string "BLEM Startup configuration"
        default "blem;true;needs_plan_b=true"
        help
            Bluetooth Manager startup configuration
```

## kaon/kaon_2_2_11_dev/opensync/3rdparty/cognitive/src/csc_man/kconfig/Kconfig.managers
```kconfig
menuconfig MANAGER_CMM
    bool "CSC Manager (CMM)"
    default y
    depends on 3RDPARTY_COGNITIVE
    help
        Enable CSC Manager (CMM)

    config MANAGER_CMM_CFG
        depends on MANAGER_CMM
        string "CSC Startup configuration"
        default "csc_man;true"
        help
            CSC Manager startup configuration

    config CSC_LIBUCI
        depends on MANAGER_CMM
        bool "libuci support"
        default n if PLATFORM_IS_BCM
        default y
        help
            libuci (unified configuration interface) can be used
            to set/get motion kernel module
```

## kaon/kaon_2_2_11_dev/opensync/3rdparty/walleye/kconfig/Kconfig.3rdparty
```kconfig
menuconfig 3RDPARTY_WALLEYE
    bool "Walleye DPI plugin support"
    default n
    depends on MANAGER_FSM
    help
        Enable Walleye DPI plugin support for FSM
```

## kaon/kaon_2_2_11_dev/opensync/core/kconfig/Kconfig
```kconfig
mainmenu "OpenSync Configuration"

menu "Common"
    menu "Managers"
        source "kconfig/Kconfig.managers"
    endmenu

    menu "Plume Options"
        config SPEEDTEST
            bool "Speedtest"
            default y
            if SPEEDTEST
                choice SELECT_SPEEDTEST
                    prompt "Choose speedtest implementation"
                    default SPEEDTEST_OOKLA

                    config SPEEDTEST_PLUME
                        bool "Plume"
                        help
                            This options enables the "st_ookla" command. This is
                            the Plume implementation of the Ookla speedtest.

                    config SPEEDTEST_OOKLA
                        bool "Ookla Official"
                        help
                            Use the official Ookla speedtest binary.
                endchoice

                if SPEEDTEST_OOKLA
                    config SPEEDTEST_NICE
                        string "Optional command to set process priority of speedtest"

                    config SPEEDTEST_URL
                        string "Speedtest URL"
                        default "http://www.speedtest.net/api/embed/plume/config"

                    config SPEEDTEST_PARAM
                        string "Additional parameters in speedtest URL"

                    choice SELECT_OOKLA_WAR
                        prompt "Choose Ookla performance work-around"
                        default OOKLA_WAR_TCP_IGNORE_CSUM

                        config OOKLA_WAR_TCP_IGNORE_CSUM
                            bool "ookla perf war: sysctl ipv4/tcp_ignore_csum"
                            help
                                Use sysctl ipv4/tcp_ignore_csum for Ookla performance improvement

                        config OOKLA_WAR_GRO
                            bool "ookla perf war: ethtool gro"
                            help
                                Use ethtool gro for Ookla performance improvement

                        config OOKLA_WAR_MODULE
                            bool "ookla perf war: kernel module"
                            help
                                Use kernel module for Ookla performance improvement
                    endchoice
                endif
            endif
    endmenu

    menu "OpenSync API"
        menu "Networking (OSN)"
            choice
                prompt "Interface L2 control"
                default OSN_BACKEND_NETIF_LINUX
                source "kconfig/Kconfig.osn.netif_backend"
            endchoice

            choice
                prompt "IPv4 networking"
                default OSN_BACKEND_IPV4_LINUX
                source "kconfig/Kconfig.osn.ipv4_backend"
            endchoice

            choice
                prompt "IPv4 routing (status reporting)"
                default OSN_BACKEND_ROUTEV4_LINUX
                source "kconfig/Kconfig.osn.routev4_backend"
            endchoice

            choice
                prompt "DHCPv4 client"
                default OSN_BACKEND_DHCPV4_CLIENT_UDHCP
                source "kconfig/Kconfig.osn.dhcpv4_client_backend"
            endchoice

            choice
                prompt "DHCPv4 server"
                default OSN_BACKEND_DHCPV4_SERVER_DNSMASQ
                source "kconfig/Kconfig.osn.dhcpv4_server_backend"
            endchoice

            choice
                prompt "UPnP"
                default OSN_BACKEND_UPNP_MINIUPNPD
                source "kconfig/Kconfig.osn.upnp_backend"
            endchoice

            choice
                prompt "IPv6 networking"
                default OSN_BACKEND_IPV6_LINUX
                source "kconfig/Kconfig.osn.ipv6_backend"
            endchoice

            choice
                prompt "DHCPv6 client"
                default OSN_BACKEND_DHCPV6_CLIENT_ODHCP6
                source "kconfig/Kconfig.osn.dhcpv6_client_backend"
            endchoice

            choice
                prompt "DHCPv6 server"
                default OSN_BACKEND_DHCPV6_SERVER_DNSMASQ6
                source "kconfig/Kconfig.osn.dhcpv6_server_backend"
            endchoice

            choice
                prompt "IPv6 Router Advertisement"
                default OSN_BACKEND_IPV6_RADV_DNSMASQ6
                source "kconfig/Kconfig.osn.ipv6_radv_backend"
            endchoice

            choice
                prompt "PPPoE"
                default OSN_BACKEND_PPPOE_LINUX
                source "kconfig/Kconfig.osn.pppoe_backend"
            endchoice

            choice
                prompt "VLAN"
                default OSN_BACKEND_VLAN_LINUX
                source "kconfig/Kconfig.osn.vlan_backend"
            endchoice

            choice
                prompt "QoS"
                default OSN_BACKEND_QOS_LINUX
                source "kconfig/Kconfig.osn.qos_backend"
            endchoice

            menu "Firewall"
                choice
                    prompt "Implementation"
                    default OSN_BACKEND_FW_IPTABLES_FULL
                    source "kconfig/Kconfig.osn.fw_backend"
                endchoice
                source "kconfig/Kconfig.osn.fw"
            endmenu

            choice
                prompt "MAP-T"
                default OSN_BACKEND_MAPT_NULL
                source "kconfig/Kconfig.osn.mapt_backend"
            endchoice

            source "kconfig/Kconfig.osn"
        endmenu

        menu "Platform (OSP)"
            comment "Unit (OSP unit)"
            choice
                prompt "OSP Unit Backend"
                source "kconfig/Kconfig.osp_unit.backend"
            endchoice

            comment "Persistent Storage (OSP_PS)"
            choice
                prompt "Persistent Storage Backend"
                source "kconfig/Kconfig.osp_ps.backend"
            endchoice
            source "kconfig/Kconfig.osp_ps"

            comment "Reboot and Related Features (OSP_REBOOT)"
            choice
                prompt "Reboot Backend"
                source "kconfig/Kconfig.osp_reboot.backend"
            endchoice
            source "kconfig/Kconfig.osp_reboot"

            comment "OSP LED"
            source "src/lib/osp/kconfig/Kconfig.osp_led"

            comment "OSP UPG"
            source "src/lib/osp/kconfig/Kconfig.osp_upg"

            comment "L2Switch control"
            choice
                prompt "L2Switch backend"
                source "kconfig/Kconfig.osp_l2switch.backend"
            endchoice

            comment "Object Management (OSP_OBJM)"
            choice
                prompt "Object Management Backend"
                source "kconfig/Kconfig.osp_objm.backend"
            endchoice
            source "kconfig/Kconfig.osp_objm"


        endmenu
    endmenu

    menu "OVSDB"
        orsource "../ovsdb/Kconfig"
    endmenu

    menu "Libs"
        rsource "Kconfig.libs"
    endmenu

    menu "Tools"
        rsource "Kconfig.tools"
    endmenu

    menu "Misc"
        orsource "../src/lib/hostap/kconfig/Kconfig"

        config REMAP_LEGACY
            bool "Remap legacy install prefix path"
            help
                Move all files from legacy location to new install prefix path
                Also replace all paths in installed scripts
    endmenu

    menu "Target"
        orsource "../src/lib/target/kconfig/Kconfig"
    endmenu

    config INSTALL_PREFIX
        string "Install prefix path"
        default "$(INSTALL_PREFIX)"

    config TARGET_NAME
        string "Device Descriptive Name"

    config TARGET_MODEL
        string "Device Model Name"

    config SKU_NUMBER
        string "Device Model Name"
	default "AR1344E"

    config VENDOR_FACTORY
        string "vendor factory"
	default "Kaon broadband"

    config VENDOR_MANUFACTURER
        string "vendor manufacturer"
	default "Kaon broadband"

    config VENDOR_MGF_DATE
        string "date of manufature"
	default "2021.05.01"

    config VENDOR_NAME
        string "Vendor Name"
	default "Kaon broadband"

    config VENDOR_PART_NUMBER
        string "Device part number"
	default "kaonar13443e"
endmenu

menu "Platform Configuration"
    orsource "Kconfig.platform"
    orsource "../platform/*/kconfig/Kconfig.platform"
endmenu

menu "Vendor Configuration"
    choice VENDOR
        prompt "Vendor Selection"
        orsource "Kconfig.vendor"
        orsource "../vendor/*/kconfig/Kconfig.vendor"
    endchoice
    orsource "../vendor/*/kconfig/Kconfig"
endmenu

menu "3rdparty Configuration"
    orsource "../3rdparty/*/kconfig/Kconfig.3rdparty"
endmenu

orsource "Kconfig.hidden"
```

## kaon/kaon_2_2_11_dev/opensync/core/kconfig/Kconfig.osp_upg
```kconfig
#
# Include core OSP UPG modules
#
source "src/lib/osp/kconfig/Kconfig.osp_upg"

#
# Include platform/vendor OSP UPG modules
#
#osource "platform/*/kconfig/Kconfig.osp_upg"
#osource "vendor/*/kconfig/Kconfig.osp_upg"
```

## kaon/kaon_2_2_11_dev/opensync/core/src/lib/osp/kconfig/Kconfig.osp_upg
```kconfig
config OSP_UPG
    bool "Enable support for OSP UPG API"
    default y
    help
        Use the new OSP UPG API
```

## kaon/kaon_2_2_11_dev/opensync/vendor/bcm-template/kconfig/Kconfig.vendor
```kconfig
menuconfig VENDOR_IS_BCM_TEMPLATE
    bool "BCM template"
    help
        OpenSync template vendor layer for BCM devices.

if VENDOR_IS_BCM_TEMPLATE

config PLUME_HARDWARE
    bool "Plume hardware"
    default n
    help
        Select 'y' when building OpenSync for Plume hardware.

config 3RDPARTY_WEBROOT
    bool "Webroot content filtering"
    default y

config 3RDPARTY_WALLEYE
    bool "Walleye DPI plugin support"
    default y
    depends on MANAGER_FSM
    help
        Enable Walleye DPI plugin support for FSM

orsource "../src/wpd/kconfig/Kconfig"
orsource "../../../3rdparty/cognitive/kconfig/Kconfig.3rdparty"

endif
```

## kaon/kaon_2_2_11_dev/opensync/vendor/bcm-template/src/tools/logread/kconfig/Kconfig.tools
```kconfig
menu "logread"
    config LOGREAD_LOG_HAS_HOSTNAME
        bool "Hostname is present in syslog messages"
        default n
        help
            This option is required to parse properly the system logs on some
            systems.

    config LOGREAD_LOG_HAS_YEAR
        bool "The syslog timestamp includes the year"
        default n
        help
            This option is required to parse properly the system logs on some
            systems.

    config LOGREAD_LOG_HAS_LEVEL
        bool "The syslog log message contains the log level"
        default n
        help
            This option is required to parse properly the system logs on some
            systems.
endmenu
```
